## sdkconfig.defaults
```kconfig
# Use custom partition table (factory + ota_0)
CONFIG_PARTITION_TABLE_CUSTOM=y
CONFIG_PARTITION_TABLE_CUSTOM_FILENAME="partitions.csv"

# 4MB flash required for factory + ota_0 layout
CONFIG_ESPTOOLPY_FLASHSIZE_4MB=y

# Enable Bluetooth (NimBLE)
CONFIG_BT_ENABLED=y
CONFIG_BT_NIMBLE_ENABLED=y

# BLE MTU — allow larger payloads for JSON transport
CONFIG_BT_NIMBLE_ATT_PREFERRED_MTU=512
```
